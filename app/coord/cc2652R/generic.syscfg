// These arguments were used when this file was generated. They will be automatically applied on subsequent loads 
// via the GUI or CLI invocations. Run CLI with '--help' for additional information on how to override these arguments.
// @cliArgs --board "/ti/boards/CC26X2R1_LAUNCHXL" --product "simplelink_cc13x2_26x2_sdk@3.40.00.02"
// @versions {"data":"2019103101","timestamp":"2019103101","tool":"1.3.1030","templates":"2019103101"}

var AESCBC = scripting.addModule("/ti/drivers/AESCBC");
var AESCCM = scripting.addModule("/ti/drivers/AESCCM");
var AESECB = scripting.addModule("/ti/drivers/AESECB");
var CCFG = scripting.addModule("/ti/devices/CCFG");
var DMA = scripting.addModule("/ti/drivers/DMA");
var ECDH = scripting.addModule("/ti/drivers/ECDH");
var ECDSA = scripting.addModule("/ti/drivers/ECDSA");
var ECJPAKE = scripting.addModule("/ti/drivers/ECJPAKE");
var NVS = scripting.addModule("/ti/drivers/NVS");
var Power = scripting.addModule("/ti/drivers/Power");
var RF = scripting.addModule("/ti/drivers/RF");
var SHA2 = scripting.addModule("/ti/drivers/SHA2");
var TRNG = scripting.addModule("/ti/drivers/TRNG");
var zstack = scripting.addModule("/ti/zstack/zstack");
var AESCBC1 = AESCBC.addInstance();
var AESCCM1 = AESCCM.addInstance();
var AESECB1 = AESECB.addInstance();
var ECDH1 = ECDH.addInstance();
var ECDSA1 = ECDSA.addInstance();
var ECJPAKE1 = ECJPAKE.addInstance();
var NVS1 = NVS.addInstance();
var SHA21 = SHA2.addInstance();
var TRNG1 = TRNG.addInstance();
var UART = scripting.addModule("/ti/drivers/UART", {}, false);
var UART1 = UART.addInstance();
var Watchdog = scripting.addModule("/ti/drivers/Watchdog", {}, false);
var Watchdog1 = Watchdog.addInstance();
var Button = scripting.addModule("/ti/drivers/apps/Button", {}, false);
var Button1 = Button.addInstance();
// Enable Bootloader - Enable ROM Bootloader, for flashing from external host
CCFG.enableBootloader = true;
// Enable Bootloader Backdoor - When enabling the Bootloader Backdoor, the Bootloader can be activated externally by pulling a pin, even when a valid flash image is present. Note, enabling the backdoor allows an external host to read back a flash image from the device
CCFG.enableBootloaderBackdoor = true;
// Trigger Level of Bootloader Backdoor - Active high or low on selected DIO to open boot loader backdoor
CCFG.levelBootloaderBackdoor = "Active low";
// Bootloader Backdoor DIO - DIO (pin) to trigger Bootloader backdoor, this pin is only needed at boot
CCFG.dioBootloaderBackdoor = 14;
// Name
CCFG.ccfgTemplate.$name = "ti_devices_CCFGTemplate0";
var Board = scripting.addModule("/ti/drivers/Board", {}, false);
var DriverLib = scripting.addModule("/ti/devices/DriverLib", {}, false);
// deviceTypeReadOnly
zstack.deviceTypeReadOnly = true;
// Name
zstack.pm.$name = "ti_zstack_pm_zstack_pm0";
// Name
zstack.rf.$name = "ti_zstack_rf_zstack_rf0";
// Primary Channels - The primary IEEE 802.15.4 frequency channels to use in network formation or joining.
zstack.rf.primaryChannels = [11,14,15,19,20,24,25];
// Secondary Channels - The secondary IEEE 802.15.4 frequency channels to use in network formation or joining. Used only after primary channel fails formation or joining.
zstack.rf.secondaryChannels = [11,12,13,14,15,16,17,18,19,20,21,22,23,24,25,26];
// Name
zstack.rf.radioConfig.$name = "ti_devices_radioconfig_settings_ieee_15_40";
// Name
zstack.rf.radioConfig.codeExportConfig.$name = "ti_devices_radioconfig_code_export_param0";
// Name
zstack.network.$name = "ti_zstack_network_zstack_network0";
// ZDSECMGR_TC_DEVICE_MAX - Defines the number of unique TC Link Keys that the network supports.
zstack.network.zdsecmgrTcDeviceMax = 200;
// Name
zstack.advanced.$name = "ti_zstack_advanced_zstack_advanced0";
// Name
zstack.advanced.routing.$name = "ti_zstack_advanced_zstack_routing0";
// Network Indirect Message Timeout (s) - Default indirect message holding timeout in seconds.
zstack.advanced.routing.nwkIndirectMsgTimeout = 10;
// Name
zstack.advanced.packetSending.$name = "ti_zstack_advanced_zstack_packet_sending0";
// Name
zstack.advanced.tableSize.$name = "ti_zstack_advanced_zstack_table_size0";
// Binding Table Size - Maximum number of entries in the binding table.
zstack.advanced.tableSize.bindingTableSize = 1;
// Routing Table Size - Maximum number of entries in the regular routing table plus additional entries for route repair.
zstack.advanced.tableSize.routingTableSize = 160;
var multi_stack_validate = scripting.addModule("/ti/easylink/multi_stack_validate", {}, false);
// Name
AESCBC1.$name = "CONFIG_AESCBC_0";
// Name
AESCCM1.$name = "CONFIG_AESCCM_0";
// Interrupt Priority - Crypto peripheral interrupt priority
AESCCM1.interruptPriority = "2";
// Name
AESECB1.$name = "CONFIG_AESECB_0";
// Interrupt Priority - Crypto peripheral interrupt priority
AESECB1.interruptPriority = "1";
// Name
ECDH1.$name = "CONFIG_ECDH_0";
// Name
ECDSA1.$name = "CONFIG_ECDSA_0";
// Name
ECJPAKE1.$name = "CONFIG_ECJPAKE_0";
// Name - The C/C++ identifier used in applications as the index parameter passed to NVS runtime APIs
NVS1.$name = "CONFIG_NVSINTERNAL";
// Name
NVS1.internalFlash.$name = "ti_drivers_nvs_NVSCC26XX0";
// Region Base - Base address of the region. Must be aligned on an integer multiple of the sector size.
NVS1.internalFlash.regionBase = 0x50000;
// Region Size - Size of the region in bytes. Must be a non-zero multiple of the Sector Size
NVS1.internalFlash.regionSize = 0x6000;
// Name
SHA21.$name = "CONFIG_SHA2_0";
// Name - The C/C++ identifier used in applications as the index parameter passed to TRNG runtime APIs
TRNG1.$name = "CONFIG_TRNG_0";
// Use Hardware - Select the hardware to use, or 'None' to use available header pins
UART1.$hardware = system.deviceData.board.components.XDS110UART;
// Name - The C/C++ identifier used in applications as the index parameter passed to UART runtime APIs
UART1.$name = "UART_0";
// Name
UART1.txPinInstance.$name = "CONFIG_PIN_0";
// Name
UART1.rxPinInstance.$name = "CONFIG_PIN_1";
// Name
UART1.uart.$name = "MyUART1";
// Name - The C/C++ identifier used in applications as the index parameter passed to Watchdog runtime APIs
Watchdog1.$name = "CONFIG_WATCHDOG_0";
// Period - Watchdog timer period in milliseconds
Watchdog1.period = 5000;
// Name
Watchdog1.watchdog.$name = "MyWDT1";
// Use Hardware - Select the hardware to use, or 'None' to use available header pins
Button1.$hardware = system.deviceData.board.components["BTN-2"];
// Name - The C/C++ identifier used in applications as the index parameter passed to Button runtime APIs
Button1.$name = "BUTTON_BOOT";
// Pull - Specifies the internal pull-up or pull-down resistor configuration of this GPIO pin.
Button1.gpioPin.pull = "Pull Up";
// Interrupt Trigger - Specifies when or if interrupts are triggered
Button1.gpioPin.interruptTrigger = "Falling Edge";
// Name - The C/C++ identifier used in applications as the index parameter passed to GPIO runtime APIs
Button1.gpioPin.$name = "RESET_BOOT";
// Name
Button1.gpioPin.pinInstance.$name = "CONFIG_PIN_2";
// Suggest solution
UART1.uart.$suggestSolution = "UART1";
// Suggest solution
UART1.uart.txPin.$suggestSolution = "8";
// Suggest solution
UART1.uart.rxPin.$suggestSolution = "7";
// Suggest solution
Watchdog1.watchdog.$suggestSolution = "WDT0";
// Suggest solution
Button1.gpioPin.gpioPin.$suggestSolution = "20";
